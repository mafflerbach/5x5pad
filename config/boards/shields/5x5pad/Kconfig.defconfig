## config/boards/shields/5x5pad/Kconfig.defconfig
```kconfig
# Copyright (c) 2020 The ZMK Contributors
# SPDX-License-Identifier: MIT

if SHIELD_5x5pad_LEFT

config ZMK_KEYBOARD_NAME
    default "5x5pad"

config ZMK_SPLIT_BLE_ROLE_CENTRAL
    default y

endif

if SHIELD_5x5pad_LEFT || SHIELD_5x5pad_RIGHT

config ZMK_SPLIT
    default y

endif
```

## config/boards/shields/5x5pad/Kconfig.shield
```kconfig
# Copyright (c) 2020 The ZMK Contributors
# SPDX-License-Identifier: MIT

config SHIELD_5x5pad_LEFT
    def_bool $(shields_list_contains,5x5pad_left)

config SHIELD_5x5pad_RIGHT
    def_bool $(shields_list_contains,5x5pad_right)
```
